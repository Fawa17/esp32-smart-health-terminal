## components/ds1302/Kconfig
```kconfig
menu "DS1302 实时时钟"

    config DS1302_CLK_GPIO
        int "SCLK 引脚号"
        default 5
        range 0 48
        help
            DS1302 的时钟线。默认 GPIO5（对应原 STM32 工程的 PB5）。
            避开 0/3/45/46（strapping）、19/20（USB）、26~37（Flash/PSRAM）。

    config DS1302_DAT_GPIO
        int "I/O 数据引脚号"
        default 6
        range 0 48
        help
            双向数据线，驱动内部会在输入/输出之间切换。
            默认 GPIO6（对应原工程的 PB6）。

    config DS1302_RST_GPIO
        int "RST(CE) 引脚号"
        default 7
        range 0 48
        help
            DS1302 的片选/复位线，高电平期间事务有效。默认 GPIO7（对应原工程的 PB7）。

    config DS1302_BIT_DELAY_US
        int "半个时钟周期的延时(微秒)"
        default 2
        range 1 50
        help
            DS1302 手册要求 SCLK 高低电平各不短于 250ns，2us 已有 8 倍余量。
            ESP32-S3 上 gpio_set_level 加上函数开销本身就有百纳秒级，
            再小就可能出现"两个电平合并成一个"的情况。
            如果杜邦线很长（>20cm）导致偶发读错，可以调到 5。

endmenu
```

## components/max30102/Kconfig
```kconfig
menu "MAX30102"

    config MAX30102_SAMPLE_TASK_STACK
        int "采样任务栈大小（字节）"
        default 3072
        help
            单位是**字节**，不是 STM32 FreeRTOS 的“字”。
            STM32 版写 80 字≈320 字节，在 ESP-IDF 下必须按字节写。
            该任务只做 I2C 读 + 填缓冲，3072 足够。

    config MAX30102_SAMPLE_TASK_PRIO
        int "采样任务优先级"
        default 15
        range 1 17
        help
            必须 ≤17。ESP-IDF 内部占用了 18(lwIP) / 22(esp_timer) /
            23(WiFi) / 24-25(IPC)，超过会把网络打崩。
            采样要跟着 100Hz 的 INT 走，比 MPU6050(14) 略高。

    config MAX30102_SAMPLE_TASK_CORE
        int "采样任务绑定核心"
        default 1
        range 0 1
        help
            核 0 留给 WiFi/MQTT 协议栈，核 1 放采集与算法。

    config MAX30102_HR_TASK_STACK
        int "心率算法任务栈大小（字节）"
        default 6144
        help
            maxim_heart_rate_and_oxygen_saturation() 内部有多组
            BUFFER_SIZE(200) 长度的 int32 数组，栈要留足。

    config MAX30102_HR_TASK_PRIO
        int "心率算法任务优先级"
        default 13
        range 1 17

    config MAX30102_HR_TASK_CORE
        int "心率算法任务绑定核心"
        default 1
        range 0 1

config MAX30102_POLL_MS
        int "采样轮询周期（毫秒）"
        default 20
        range 10 100
        help
            芯片固定 100 sps，代码按"每 N ms 取 N/10 个样本"与之 1:1 对齐。

            10 = 每 10ms 读 1 个样本（旧行为，100 次总线事务/秒）；
            20 = 每 20ms 读 2 个样本（事务数减半，默认）；
            50 = 每 50ms 读 5 个样本（事务数降到 1/5，延迟稍大）。

            上限 100 是保守值：FIFO 深度 32，100ms 只攒 10 个，仍有 320ms 余量。
            改大不会丢数据，只会让心率窗口攒满得慢一点（200 点 = 2 秒）。

    config MAX30102_DEBUG_DIAG
        bool "打印周期诊断（每 5 秒一行体检报告）"
        default n
        help
            打开后每 5 秒打印 FIFO 写/读指针、中断计数、窗口进度、
            片内温度、0x00~0x06 整块寄存器快照。

            作用是把"没数"的原因直接说清楚：写指针不动 = 芯片没在采样；
            指针在动但中断为 0 = INT 线没接；数据进了 FIFO 却没被读走 = 读的节奏不对。

            默认关闭 —— 它每 5 秒刷 3 行，会把 OTA / MQTT / 看门狗的日志盖住。
            调这颗芯片时再打开。注意：掉线检测不受它影响。

endmenu
```

## components/mpu6050/Kconfig
```kconfig
menu "MPU6050 驱动"

    config MPU6050_TASK_STACK
        int "采样任务栈大小（字节）"
        range 2048 8192
        default 3072
        help
            注意 ESP-IDF 的 xTaskCreate 栈参数单位是【字节】，不是 STM32 工程里的"字"。
            原工程 CFG_STK_MPU = 80（字）= 320 字节，在 IDF 里必然栈溢出，
            因为 ESP_LOG / I2C 驱动调用都比裸机 HAL 重得多。3072 字节是实测余量充足的值。

    config MPU6050_TASK_PRIO
        int "采样任务优先级"
        range 1 17
        default 14
        help
            上限是 17。ESP-IDF 内部占用了更高优先级：
            lwIP=18、esp_timer=22、WiFi=23、IPC=24/25。
            把应用任务设到 18 以上会饿死网络栈，表现为 MQTT 断连、ping 超时。

    config MPU6050_TASK_CORE
        int "采样任务绑定的核"
        range 0 1
        default 1
        help
            核 0 跑 WiFi/lwIP 协议栈和大部分系统任务，采样/算法/显示放核 1 可以减少被抢占。

    config MPU6050_SAMPLE_PERIOD_MS
        int "采样周期（毫秒）"
        range 10 200
        default 40
        help
            原工程 40ms（25Hz）。计步/跌倒的阈值（300ms/800ms/1500ms）是按这个周期调的，
            改成其它值需要重新标定 STEP_*/FALL_* 参数。

endmenu
```

## components/net_app/Kconfig
```kconfig
menu "Network (WiFi + MQTT)"

    config NET_WIFI_SSID
        string "WiFi 名称（SSID）"
        default "ESP"
        help
            原 STM32 工程里硬编码在 ESP8266.c 的 AT+CWJAP 命令中，就是 "ESP"。
            用手机热点的话，"ESP" 就是热点的名字。

    config NET_WIFI_PASSWORD
        string "WiFi 密码"
        default "12345678"
        help
            留空表示开放网络。注意 ESP32 只支持 2.4GHz，5GHz 热点连不上。

    config NET_MQTT_URI
        string "MQTT broker 地址"
        default "mqtt://broker.emqx.io:1883"
        help
            mqtt://  明文 1883
            mqtts:// TLS 8883（需要 CA 证书，体积会增加约 8KB）
            公共测试 broker 用 broker.emqx.io，换成自己的内网地址也行。

    config NET_MQTT_CLIENT_ID
        string "MQTT 客户端 ID"
        default "my_device_001"
        help
            同一个 broker 上 client_id 必须唯一，两个设备用同一个 ID
            会互相把对方踢下线。

    config NET_TOPIC_PREFIX
        string "主题前缀"
        default "device/my_device_001"
        help
            实际用到四个主题：
                <前缀>/data    上行遥测
                <前缀>/set     下行命令
                <前缀>/ack     命令回执
                <前缀>/status  在线状态（遗嘱消息，retain）

    config NET_MQTT_USERNAME
        string "MQTT 用户名（可空）"
        default ""

    config NET_MQTT_PASSWORD
        string "MQTT 密码（可空）"
        default ""

    config NET_MQTT_QOS
        int "上报 QoS"
        range 0 1
        default 1
        help
            0 = 发出去就不管（可能丢）
            1 = 至少送达一次（broker 回 PUBACK，最多重发一次）
            2 = 恰好一次（握手三次，代价大，本项目不需要）

    config NET_UPLINK_PERIOD_MS
        int "上报周期（毫秒）"
        default 2000
        help
            原工程 NET_UPLINK_PERIOD_MS 也是 2 秒。

    config NET_UPLINK_TASK_STACK
        int "上报任务栈大小（字节）"
        default 4096
        help
            注意 ESP-IDF 里栈的单位是字节，不是字。
            snprintf 拼 JSON 会用到不少栈，4KB 比较稳妥。

    config NET_UPLINK_TASK_PRIO
        int "上报任务优先级"
        range 1 17
        default 8
        help
            ESP-IDF 内部任务的优先级：lwIP 18、esp_timer 22、WiFi 23、IPC 24/25。
            所以设置的任务不要超过 17，否则会把网络协议栈饿死。

endmenu
```

## components/watchdog/Kconfig
```kconfig
# watchdog 组件配置
#
# 三个数字的取值逻辑：
#   - 监控周期要比最快的业务任务周期还快，否则判断有延迟；200ms 够用
#   - TWDT 超时要比"最长的不打卡间隙"大。监控任务 200ms 打一次卡，
#     所以 10 秒已经非常宽松，只用来抓"监控任务自己都卡死了"这种极端情况
#   - MAX_MISS=3：第一次超时先尝试恢复，第三次还不行就复位

menu "看门狗"

config WATCHDOG_TASK_STACK
    int "监控任务栈大小（字节）"
    default 3072
    range 1536 8192
    help
        注意：ESP-IDF 的 xTaskCreate 里栈深单位是**字节**，不是 STM32 那样的"字"。
        3072 字节对这个只做计时比较的任务非常充裕。

config WATCHDOG_TASK_PRIO
    int "监控任务优先级"
    default 17
    range 1 17
    help
        上限是 17。ESP-IDF 内置任务用了更高的号：
        lwIP=18、esp_timer=22、WiFi=23、IPC=24/25。超过 17 会把协议栈饿死，
        表现出来是 WiFi 断流、MQTT keepalive 超时。

config WATCHDOG_TASK_CORE
    int "监控任务所在核心"
    default 0
    range 0 1
    help
        放在 CPU0（协议栈和 main 任务所在核）。业务任务大多在 CPU1，
        这样某一核整体卡死时，另一核的监控还能发现并复位。

config WATCHDOG_PERIOD_MS
    int "心跳检查周期（毫秒）"
    default 200
    range 50 2000

config WATCHDOG_TWDT_TIMEOUT_S
    int "任务看门狗 TWDT 超时（秒）"
    default 10
    range 3 60
    help
        这个超时针对的是"监控任务自己"。监控任务每 200ms reset 一次，
        所以正常情况永远碰不到。

config WATCHDOG_MAX_MISS
    int "连续超时几次后复位"
    default 3
    range 1 10
    help
        第 1 次超时会调用恢复回调（如果注册了），第 N 次仍超时就记下
        "哪个任务卡死"并 esp_restart()。

endmenu
```
